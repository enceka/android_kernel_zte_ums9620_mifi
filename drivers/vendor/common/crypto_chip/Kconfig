## drivers/vendor/common/crypto_chip/Kconfig
```kconfig
config ZTE_CRYPTO_CHIP
	bool "ZTE_CRYPTO_CHIP"
		depends on I2C
		default n
		help
		  Say Y here if you have zte crypto chip.
		  If unsure, say N.

config ZTE_CRYPTO_ATSHA204A
	bool "ZTE_CRYPTO_ATSHA204A"
		depends on I2C
		default n
		help
		  Say Y here if you have crypto atsha204a chip.
		  If unsure, say N.

config ZTE_CRYPTO_VEB_A5
	tristate "ZTE_CRYPTO_VEB_A5"
		depends on SPI
		default n
		help
		  Say Y here to build support for crypto veb a5 new.
		  To compile this driver as a module, choose M here.
```

## drivers/vendor/common/fingerprint/chipone/Kconfig
```kconfig
#
# chipone Fingerprint driver configuration
#

config PLATFORM_FINGERPRINT_CHIPONE
       bool "generic chipone fingerprint driver"
       default n
       help
       add support for chipone fingerprint driver.

config CHIPONE_NAV_NEW
       bool "chipone Fingerprint nav new"
       default n
       help
       CHIPONE Fingerprint nav new

config CHIPONE_NAV_NEW_NEW
       bool "chipone Fingerprint nav new new"
       default n
       help
       CHIPONE Fingerprint nav new new

config CHIPONE_NAV_NEW_NEW_NEW
       bool "chipone Fingerprint nav new new new"
       default n
       help
       CHIPONE Fingerprint nav new new new
```

## drivers/vendor/common/fingerprint/focaltech/Kconfig
```kconfig
#
# focaltech Fingerprint driver configuration
#

config PLATFORM_FINGERPRINT_FOCALTECH
       bool "generic focaltech_FT9371S6 fingerprint driver"
       default n
       help
       add support for focaltech fingerprint driver.
```

## drivers/vendor/common/fingerprint/focaltech_v2/Kconfig
```kconfig
#
# focaltech Fingerprint driver configuration
#

config PLATFORM_FINGERPRINT_FOCALTECH_V2
       bool "generic focaltech_FT9391SD fingerprint driver"
       default n
       help
       add support for focaltech fingerprint driver.
```

## drivers/vendor/common/sensor/skey/Kconfig
```kconfig
config SKEY_SENSOR_AW9620X
	tristate "SKEY_SENSOR_AW9620X"
		depends on I2C
		default n
		help
			Say Y here to build support for sensor hub new.
			To compile this driver as a module, choose M here.
```

## drivers/vendor/common/touchscreen_v2/focaltech_touch_ufp_v4_1/Kconfig
```kconfig
#
# Focaltech Touchscreen driver configuration
#

config TOUCHSCREEN_FTS_UFP_V4_1
    tristate "Focaltech Touchscreen"
    default n
    help
      Say Y here if you have Focaltech touch panel.
      If unsure, say N.
```

## drivers/vendor/common/touchscreen_v2/focaltech_touch_v4_1/Kconfig
```kconfig
#
# Focaltech Touchscreen driver configuration
#

config TOUCHSCREEN_FTS_V4_1
    tristate "Focaltech Touchscreen"
    default n
    help
      Say Y here if you have Focaltech touch panel.
      If unsure, say N.
```

## drivers/vendor/common/touchscreen_v2/hxchipset_v3_3/Kconfig
```kconfig
#
# Himax Touchscreen driver configuration
#

config TOUCHSCREEN_HIMAX_CHIPSET_V3_3
	bool "Himax touchpanel CHIPSET"
	default n
	help
	  Say Y here if you have a Himax CHIPSET touchscreen.
	  HIMAX controllers are multi touch controllers which can
	  report 10 touches at a time.
	  If unsure, say N.

config TOUCHSCREEN_HIMAX_COMMON
        bool "HIMAX chipset touchscreen"
		depends on TOUCHSCREEN_HIMAX_CHIPSET_V3_3
		default n
		help
		This enables support for HIMAX CHIPSET touchscreens.

config TOUCHSCREEN_HIMAX_IC_HX83108A
        bool "HIMAX chipset HX83108A function"
		depends on TOUCHSCREEN_HIMAX_CHIPSET_V3_3
		default n
		help
		This enables support for HIMAX CHIPSET of HX83108A.

config TOUCHSCREEN_HIMAX_IC_HX83102J
        bool "HIMAX chipset HX83102J function"
		depends on TOUCHSCREEN_HIMAX_CHIPSET_V3_3
		default n
		help
		This enables support for HIMAX CHIPSET of HX83102J.

config TOUCHSCREEN_HIMAX_IC_HX83112F
        bool "HIMAX chipset HX83112f function"
		depends on TOUCHSCREEN_HIMAX_CHIPSET_V3_3
		default n
		help
		This enables support for HIMAX CHIPSET of HX83112F.

config TOUCHSCREEN_HIMAX_IC_HX83121A
        bool "HIMAX chipset HX83121A function"
		depends on TOUCHSCREEN_HIMAX_CHIPSET_V3_3
		default n
		help
		This enables support for HIMAX CHIPSET of HX83121A.

config TOUCHSCREEN_HIMAX_IC_HX83122A
        bool "HIMAX chipset HX83122A function"
		depends on TOUCHSCREEN_HIMAX_CHIPSET_V3_3
		default n
		help
		This enables support for HIMAX CHIPSET of HX83122A.

config TOUCHSCREEN_HIMAX_IC_HX8530K
        bool "HIMAX chipset HX8530K function"
		depends on TOUCHSCREEN_HIMAX_CHIPSET_V3_3
		default n
		help
		This enables support for HIMAX CHIPSET of HX8530K.

config TOUCHSCREEN_HIMAX_DEBUG
        bool "HIMAX debug function"
		depends on TOUCHSCREEN_HIMAX_CHIPSET_V3_3
		default n
		help
		This enables support for HIMAX debug function.
config TOUCHSCREEN_HIMAX_INSPECT
        bool "HIMAX inspect function"
		depends on TOUCHSCREEN_HIMAX_CHIPSET_V3_3
		default n
		help
		This enables support for HIMAX inspect function.

config TOUCHSCREEN_HIMAX_EMBEDDED_FIRMWARE
		bool "HIMAX embedded firmware function"
		depends on TOUCHSCREEN_HIMAX_CHIPSET_V3_3
		default n
		help
		This enables built-in FW inside kernel as binary array

config HMX_DB
	bool "HIMAX driver test over Dragon Board"
	depends on TOUCHSCREEN_HIMAX_CHIPSET_V3_3
	default n
	help
	  This enables support for HIMAX driver test over Dragon Board.

config HIMAX_SUPPORT_KERNEL_419
        bool "HIMAX support kernel 4.19"
		depends on TOUCHSCREEN_HIMAX_CHIPSET_V3_3
		default n
		help
		This enables support for support kernel 4.19.
```
